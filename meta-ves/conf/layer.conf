## meta-ves/conf/layer.conf
```bitbake
# We have a conf and classes directory, add to BBPATH
BBPATH .= ":${LAYERDIR}"

# We have recipes-* directories, add to BBFILES
BBFILES += "${LAYERDIR}/recipes-*/*/*.bb \
            ${LAYERDIR}/recipes-*/*/*.bbappend"

BBFILE_COLLECTIONS += "ves-layer"
BBFILE_PATTERN_ves-layer := "^${LAYERDIR}/"
LAYERSERIES_COMPAT_ves-layer := "honister kirkstone"
```

## meta-ves/conf/machine/include/ves-compute-singlehost.inc
```bitbake
MACHINEOVERRIDES =. "vs-compute-singlehost:"

require conf/machine/include/ves-compute.inc
```

## meta-ves/conf/machine/include/ves-compute.inc
```bitbake
MACHINEOVERRIDES =. "vs-compute:"

require conf/machine/include/ves-withhost.inc
```

## meta-ves/meta-ves-vss2249p/conf/layer.conf
```bitbake
# We have a conf and classes directory, add to BBPATH
BBPATH .= ":${LAYERDIR}"

# We have recipes-* directories, add to BBFILES
BBFILES += "${LAYERDIR}/recipes-*/*/*.bb \
            ${LAYERDIR}/recipes-*/*/*.bbappend"

BBFILE_COLLECTIONS += "ves-vss2249p-layer"
BBFILE_PATTERN_ves-vss2249p-layer := "^${LAYERDIR}/"

LAYERSERIES_COMPAT_ves-vss2249p-layer := "honister kirkstone"
```
